## boards/shields/spacemousemacropad/Kconfig.shield
```kconfig
# boards/shields/spacemousemacropad/Kconfig.shield

config SHIELD_SPACEMOUSEMACROPAD
    def_bool $(shields_list_contains,spacemousemacropad)
```
